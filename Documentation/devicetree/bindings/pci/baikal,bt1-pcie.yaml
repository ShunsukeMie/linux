## Documentation/devicetree/bindings/pci/snps,dw-pcie.yaml
```yaml
# SPDX-License-Identifier: GPL-2.0
%YAML 1.2
---
$id: http://devicetree.org/schemas/pci/snps,dw-pcie.yaml#
$schema: http://devicetree.org/meta-schemas/core.yaml#

title: Synopsys DesignWare PCIe interface

maintainers:
  - Jingoo Han <jingoohan1@gmail.com>
  - Gustavo Pimentel <gustavo.pimentel@synopsys.com>

description: |
  Synopsys DesignWare PCIe host controller

# Please create a separate DT-schema for the particular DWC PCIe Root Port
# controller and make sure it's assigned with the vendor-specific
# compatible string together with the generic Synopsys DWC PCIe strings so
# the bindings would be evaluated against that schema.
select: false

allOf:
  - $ref: /schemas/pci/pci-bus.yaml#
  - $ref: /schemas/pci/snps,dw-pcie-common.yaml#

properties:
  compatible:
    anyOf:
      - description:
          DWC PCIe Root Port controller (IP-core version is explicitly
          specified in the additional compatible string)
        contains:
          allOf:
            - pattern: '^snps,dw-pcie-[0-9]+\.[0-9]+a?$'
            - const: snps,dw-pcie
      - description:
          DWC PCIe Root Port controller (IP-core version is either unknown
          or can be read from the PCIe version register of the PL reg-space)
        contains:
          const: snps,dw-pcie

  reg:
    description: |
      It should contain Data Bus Interface (dbi) and config registers for all
      versions.
      For designware core version >= 4.80, it may contain ATU address space.
    minItems: 2
    maxItems: 5

  reg-names:
    minItems: 2
    maxItems: 5
    items:
      enum: [ dbi, dbi2, config, atu, app, elbi, mgmt, ctrl, parf, cfg, link,
              ulreg, smu, mpu, apb, phy ]

  interrupts: true

  interrupt-names: true

  clocks: true

additionalProperties: true

required:
  - compatible
  - reg
  - reg-names

examples:
  - |
    pcie@dfc00000 {
      compatible = "vendor,soc-pcie", "snps,dw-pcie";
      device_type = "pci";
      reg = <0xdfc00000 0x0001000>, /* IP registers */
            <0xd0000000 0x0002000>; /* Configuration space */
      reg-names = "dbi", "config";
      #address-cells = <3>;
      #size-cells = <2>;
      ranges = <0x81000000 0 0x00000000 0xde000000 0 0x00010000>,
               <0x82000000 0 0xd0400000 0xd0400000 0 0x0d000000>;
      bus-range = <0x0 0xff>;

      interrupts = <25>, <24>;
      #interrupt-cells = <1>;

      reset-gpios = <&port0 0 1>;

      phys = <&pcie_phy>;
      phy-names = "pcie";

      num-lanes = <1>;
      max-link-speed = <3>;
    };
```

## drivers/pci/endpoint/functions/Kconfig
```kconfig
# SPDX-License-Identifier: GPL-2.0
#
# PCI Endpoint Functions
#

config PCI_EPF_TEST
	tristate "PCI Endpoint Test driver"
	depends on PCI_ENDPOINT
	select CRC32
	help
	   Enable this configuration option to enable the test driver
	   for PCI Endpoint.

	   If in doubt, say "N" to disable Endpoint test driver.

config PCI_EPF_NTB
	tristate "PCI Endpoint NTB driver"
	depends on PCI_ENDPOINT
	select CONFIGFS_FS
	help
	  Select this configuration option to enable the Non-Transparent
	  Bridge (NTB) driver for PCI Endpoint. NTB driver implements NTB
	  controller functionality using multiple PCIe endpoint instances.
	  It can support NTB endpoint function devices created using
	  device tree.

	  If in doubt, say "N" to disable Endpoint NTB driver.

config PCI_EPF_VNTB
	tristate "PCI Endpoint NTB driver"
	depends on PCI_ENDPOINT
	depends on NTB
	select CONFIGFS_FS
	help
	  Select this configuration option to enable the Non-Transparent
	  Bridge (NTB) driver for PCIe Endpoint. NTB driver implements NTB
	  between PCI Root Port and PCIe Endpoint.

	  If in doubt, say "N" to disable Endpoint NTB driver.

menuconfig PCI_EPF_VNET
	tristate "PCI Endpoint virtio-net driver"
	depends on PCI_ENDPOINT
	select PCI_ENDPOINT_VIRTIO
	select VHOST_RING
	select VHOST_IOMEM
	help
	  PCIe Endpoint virtio-net function implementation. This module enables to
	  show the virtio-net as pci device to PCIe Host side, and, another
	  virtio-net device show to local machine. Those devices can communicate
	  each other.

config PCI_EPF_VNET_ROCE
	tristate "Support RoCE feature"
	depends on PCI_EPF_VNET
	help
	  This configuration enables to RDMA feature to PCI Endpoint virtio-net driver.
```
