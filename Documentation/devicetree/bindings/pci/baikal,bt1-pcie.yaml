## Documentation/devicetree/bindings/pci/baikal,bt1-pcie.yaml
```yaml
# SPDX-License-Identifier: (GPL-2.0-only OR BSD-2-Clause)
%YAML 1.2
---
$id: http://devicetree.org/schemas/pci/baikal,bt1-pcie.yaml#
$schema: http://devicetree.org/meta-schemas/core.yaml#

title: Baikal-T1 PCIe Root Port Controller

maintainers:
  - Serge Semin <fancer.lancer@gmail.com>

description:
  Embedded into Baikal-T1 SoC Root Complex controller. It's based on the
  DWC RC PCIe v4.60a IP-core, which is configured to have just a single Root
  Port function and is capable of establishing the link up to Gen.3 speed
  on x4 lanes. It doesn't have embedded clock and reset control module, so
  the proper interface initialization is supposed to be performed by software.

select:
  properties:
    compatible:
      contains:
        const: baikal,bt1-pcie

  required:
    - compatible

allOf:
  - $ref: /schemas/pci/snps,dw-pcie.yaml#

properties:
  compatible:
    items:
      - const: baikal,bt1-pcie
      - const: snps,dw-pcie-4.60a
      - const: snps,dw-pcie

  reg:
    description:
      DBI, DBI2 and at least 4KB outbound iATU-capable region.
    maxItems: 3

  reg-names:
    minItems: 3
    maxItems: 3
    items:
      enum: [ dbi, dbi2, config ]

  interrupts:
    description:
      MSI, AER, PME, Hot-plug, Link Bandwidth Management, Link Equalization
      request and eight Read/Write eDMA IRQ lines are available.
    maxItems: 14

  interrupt-names:
    minItems: 14
    maxItems: 14
    items:
      oneOf:
        - pattern: '^dma[0-7]$'
        - enum: [ msi, aer, pme, hp, bw_mg, l_eq ]

  clocks:
    description:
      DBI (attached to the APB bus), AXI-bus master and slave interfaces
      are fed up by the dedicated application clocks. A common reference
      clock signal is supposed to be attached to the corresponding Ref-pad
      of the SoC. It will be redistributed amongst the controller core
      sub-modules (pipe, core, aux, etc).
    minItems: 4
    maxItems: 4

  clock-names:
    minItems: 4
    maxItems: 4
    items:
      enum: [ dbi, mstr, slv, ref ]

  resets:
    description:
      A comprehensive controller reset logic is supposed to be implemented
      by software, so almost all the possible application and core reset
      signals are exposed via the system CCU module.
    minItems: 9
    maxItems: 9

  reset-names:
    minItems: 9
    maxItems: 9
    items:
      enum: [ mstr, slv, pwr, hot, phy, core, pipe, sticky, non-sticky ]

  baikal,bt1-syscon:
    $ref: /schemas/types.yaml#/definitions/phandle
    description:
      Phandle to the Baikal-T1 System Controller DT node. It's required to
      access some additional PM, Reset-related and LTSSM signals.

  num-lanes:
    maximum: 4

  max-link-speed:
    maximum: 3

  num-ob-windows:
    const: 4

  num-ib-windows:
    const: 4

required:
  - compatible
  - reg
  - reg-names
  - interrupts
  - interrupt-names

unevaluatedProperties: false

examples:
  - |
    pcie@1f052000 {
      compatible = "baikal,bt1-pcie", "snps,dw-pcie-4.60a", "snps,dw-pcie";
      device_type = "pci";
      reg = <0x1f052000 0x1000>, <0x1f053000 0x1000>, <0x1bdbf000 0x1000>;
      reg-names = "dbi", "dbi2", "config";
      #address-cells = <3>;
      #size-cells = <2>;
      ranges = <0x81000000 0 0x00000000 0x1bdb0000 0 0x00008000>,
               <0x82000000 0 0x20000000 0x08000000 0 0x13db0000>;
      bus-range = <0x0 0xff>;

      interrupts = <0 80 4>, <0 81 4>, <0 82 4>, <0 83 4>,
                   <0 84 4>, <0 85 4>, <0 86 4>, <0 87 4>,
                   <0 88 4>, <0 89 4>, <0 90 4>, <0 91 4>,
                   <0 92 4>, <0 93 4>;
      interrupt-names = "dma0", "dma1", "dma2", "dma3", "dma4", "dma5", "dma6",
                        "dma7", "msi", "aer", "pme", "hp", "bw_mg", "l_eq";

      clocks = <&ccu_sys 1>, <&ccu_axi 6>, <&ccu_axi 7>, <&clk_pcie>;
      clock-names = "dbi", "mstr", "slv", "ref";

      resets = <&ccu_axi 6>, <&ccu_axi 7>, <&ccu_sys 7>, <&ccu_sys 10>,
               <&ccu_sys 4>, <&ccu_sys 6>, <&ccu_sys 5>, <&ccu_sys 8>,
               <&ccu_sys 9>;
      reset-names = "mstr", "slv", "pwr", "hot", "phy", "core", "pipe",
                    "sticky", "non-sticky";

      reset-gpios = <&port0 0 1>;

      num-lanes = <4>;
      max-link-speed = <3>;
    };
...
```

## Documentation/devicetree/bindings/pci/snps,dw-pcie-common.yaml
```yaml
# SPDX-License-Identifier: (GPL-2.0-only OR BSD-2-Clause)
%YAML 1.2
---
$id: http://devicetree.org/schemas/pci/snps,dw-pcie-common.yaml#
$schema: http://devicetree.org/meta-schemas/core.yaml#

title: Synopsys DWC PCIe RP/EP controller

maintainers:
  - Jingoo Han <jingoohan1@gmail.com>
  - Gustavo Pimentel <gustavo.pimentel@synopsys.com>

description:
  Generic Synopsys DesignWare PCIe Root Port and Endpoint controller
  properties.

select: false

properties:
  reg:
    description:
      DWC PCIe CSR space is normally accessed over the dedicated Data Bus
      Interface - DBI. In accordance with the reference manual the register
      configuration space belongs to the Configuration-Dependent Module (CDM)
      and is split up into several sub-parts Standard PCIe configuration
      space, Port Logic Registers (PL), Shadow Config-space Registers,
      iATU/eDMA registers. The particular sub-space is selected by the
      CDM/ELBI (dbi_cs) and CS2 (dbi_cs2) signals (selector bits). Such
      configuration provides a flexible interface for the system engineers to
      either map the particular space at a desired MMIO address or just leave
      them in a contiguous memory space if pure Native or AXI Bridge DBI access
      is selected. Note the PCIe CFG-space, PL and Shadow registers are
      specific for each activated function, while the rest of the sub-spaces
      are common for all of them (if there are more than one).
    minItems: 2
    maxItems: 6

  reg-names:
    minItems: 2
    maxItems: 6

  interrupts:
    description:
      There are two main sub-blocks which are normally capable of
      generating interrupts. It's System Information Interface and MSI
      interface. While the former one has some common for the Host and
      Endpoint controllers IRQ-signals, the later interface is obviously
      Root Complex specific since it's responsible for the incoming MSI
      messages signalling. The System Information IRQ signals are mainly
      responsible for reporting the generic PCIe hierarchy and Root
      Complex events like VPD IO request, general AER, PME, Hot-plug, link
      bandwidth change, link equalization request, INTx asserted/deasserted
      Message detection, embedded DMA Tx/Rx/Error.
    minItems: 1
    maxItems: 26

  interrupt-names:
    minItems: 1
    maxItems: 26

  phys:
    description:
      There can be up to the number of possible lanes PHYs specified.
      Obviously each specified PHY is supposed to be able to work in the
      PCIe mode with a speed implied by the DWC PCIe controller it is
      attached to.
    minItems: 1
    maxItems: 16

  phy-names:
    minItems: 1
    maxItems: 16
    items:
      pattern: '^pcie([0-9]+|-?phy[0-9]*)?$'

  reset-gpio:
    deprecated: true
    description:
      Reference to the GPIO-controlled PERST# signal. It is used to reset all
      the peripheral devices available on the PCIe bus.
    maxItems: 1

  reset-gpios:
    description:
      Reference to the GPIO-controlled PERST# signal. It is used to reset all
      the peripheral devices available on the PCIe bus.
    maxItems: 1

  max-link-speed:
    maximum: 5

  num-lanes:
    description:
      Number of PCIe link lanes to use. Can be omitted should the already
      brought up link is supposed to be preserved.
    maximum: 16

  num-ob-windows:
    $ref: /schemas/types.yaml#/definitions/uint32
    deprecated: true
    description:
      Number of outbound address translation windows. This parameter can be
      auto-detected based on the iATU memory writability. So there is no
      point in having a dedicated DT-property for it.
    maximum: 256

  num-ib-windows:
    $ref: /schemas/types.yaml#/definitions/uint32
    deprecated: true
    description:
      Number of inbound address translation windows. In the same way as
      for the outbound AT windows, this parameter can be auto-detected based
      on the iATU memory writability. There is no point having a dedicated
      DT-property for it either.
    maximum: 256

  num-viewport:
    $ref: /schemas/types.yaml#/definitions/uint32
    deprecated: true
    description:
      Number of outbound view ports configured in hardware. It's the same as
      the number of outbound AT windows.
    maximum: 256

  snps,enable-cdm-check:
    $ref: /schemas/types.yaml#/definitions/flag
    description:
      Enable automatic checking of CDM (Configuration Dependent Module)
      registers for data corruption. CDM registers include standard PCIe
      configuration space registers, Port Logic registers, DMA and iATU
      registers. This feature has been available since DWC PCIe v4.80a.

additionalProperties: true

definitions:
  reg-names:
    description:
      CSR space names common for the DWC PCIe Root Port and Endpoint
      controllers.
    oneOf:
      - description:
          Basic DWC PCIe controller configuration-space accessible over
          the DBI interface. This memory space is either activated with
          CDM/ELBI = 0 and CS2 = 0 or is a contiguous memory region
          with all spaces. Note iATU/eDMA CSRs are indirectly accessible
          via the PL viewports on the DWC PCIe controllers older than
          v4.80a.
        const: dbi
      - description:
          Shadow DWC PCIe config-space registers. This space is selected
          by setting CDM/ELBI = 0 and CS2 = 1. This is an intermix of
          the PCI-SIG PCIe CFG-space with the shadow registers for some
          PCI Header space, PCI Standard and Extended Structures. It's
          mainly relevant for the end-point controller configuration,
          but still there are some shadow registers available for the
          Root Port mode too.
        const: dbi2
      - description:
          External Local Bus registers. It's an application-dependent
          registers normally defined by the platform engineers. The space
          can be selected by setting CDM/ELBI = 1 and CS2 = 0 wires or can
          be accessed over some platform-specific means (for instance
          as a part of a system controller).
        enum: [ elbi, app ]
      - description:
          iATU/eDMA registers common for all device functions. It's an
          unrolled memory space with the internal Address Translation
          Unit and Enhanced DMA, which is selected by setting CDM/ELBI = 1
          and CS2 = 1. For IP-core releases prior v4.80a, these registers
          have been programmed via an indirect addressing scheme using a
          set of viewport CSRs mapped into the PL space. Note iATU is
          normally mapped to the 0x0 address of this region, while eDMA
          is available at 0x80000 base address.
        const: atu
      - description:
          Platform-specific eDMA registers. Some platforms may have eDMA
          CSRs mapped in a non-standard base address. The registers offset
          can be changed or the MS/LS-bits of the address can be attached
          in an additional RTL block before the MEM-IO transactions reach
          the DW PCIe slave interface.
        const: dma
      - description:
          PHY/PCS configuration registers. Some platforms can have the
          PCS and PHY CSRs accessible over a dedicated memory mapped
          region, but mainly these registers are indirectly accessible
          either by means of the embedded PHY viewport schema or by some
          platform-specific method.
        const: phy

  interrupt-names:
    description:
      IRQ signal names common for the DWC PCIe Root Port and Endpoint
      controllers.
    oneOf:
      - description:
          Controller request to read or write virtual product data
          from/to the VPD capability registers.
        const: vpd
      - description:
          Link Equalization Request flag is set in the Link Status 2
          register (applicable if the corresponding IRQ is enabled in
          the Link Control 3 register).
        const: l_eq
      - description:
          Indicates that the eDMA Tx/Rx transfer is complete or that an
          error has occurred on the corresponding channel. eDMA can have
          eight Tx (Write) and Rx (Read) eDMA channels thus supporting up
          to 16 IRQ signals all together. Write eDMA channels shall go
          first in the ordered row as per default edma_int[*] bus setup.
        pattern: '^dma([0-9]|1[0-5])?$'
      - description:
          PCIe protocol correctable error or a Data Path protection
          correctable error is detected by the automotive/safety
          feature.
        const: sft_ce
      - description:
          Indicates that the internal safety mechanism detected and
          uncorrectable error.
        const: sft_ue

...
```

## Documentation/devicetree/bindings/pci/snps,dw-pcie-ep.yaml
```yaml
# SPDX-License-Identifier: GPL-2.0
%YAML 1.2
---
$id: http://devicetree.org/schemas/pci/snps,dw-pcie-ep.yaml#
$schema: http://devicetree.org/meta-schemas/core.yaml#

title: Synopsys DesignWare PCIe endpoint interface

maintainers:
  - Jingoo Han <jingoohan1@gmail.com>
  - Gustavo Pimentel <gustavo.pimentel@synopsys.com>

description: |
  Synopsys DesignWare PCIe host controller endpoint

# Please create a separate DT-schema for the particular DWC PCIe Endpoint
# controller and make sure it's assigned with the vendor-specific
# compatible string together with the generic Synopsys DWC PCIe strings so
# the bindings would be evaluated against that schema.
select: false

allOf:
  - $ref: /schemas/pci/pci-ep.yaml#
  - $ref: /schemas/pci/snps,dw-pcie-common.yaml#

properties:
  compatible:
    anyOf:
      - description:
          DWC PCIe Endpoint controller (IP-core version is explicitly
          specified in the additional compatible string)
        contains:
          allOf:
            - pattern: '^snps,dw-pcie-ep-[0-9]+\.[0-9]+a?$'
            - const: snps,dw-pcie-ep
      - description:
          DWC PCIe Endpoint controller (IP-core version is either unknown
          or can be read from the PCIe version register of the PL reg-space)
        contains:
          const: snps,dw-pcie-ep

  reg:
    description: |
      It should contain Data Bus Interface (dbi) and config registers for all
      versions.
      For designware core version >= 4.80, it may contain ATU address space.
    minItems: 2
    maxItems: 4

  reg-names:
    minItems: 2
    maxItems: 4
    items:
      enum: [dbi, dbi2, config, atu, addr_space, link, atu_dma, appl]

required:
  - compatible
  - reg
  - reg-names

additionalProperties: true

examples:
  - |
    pcie-ep@dfd00000 {
      compatible = "vendor,soc-pcie", "snps,dw-pcie-ep";
      reg = <0xdfc00000 0x0001000>, /* IP registers 1 */
            <0xdfc01000 0x0001000>, /* IP registers 2 */
            <0xd0000000 0x2000000>; /* Configuration space */
      reg-names = "dbi", "dbi2", "addr_space";

      phys = <&pcie_phy0>, <&pcie_phy1>, <&pcie_phy2>, <&pcie_phy3>;
      phy-names = "pcie0", "pcie1", "pcie2", "pcie3";

      max-link-speed = <3>;
    };
```
